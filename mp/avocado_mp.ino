#include <Wire.h>
#include <Servo.h>

const int I2C_SLAVE_ADDRESS = 0x04;
const int SERVO_NUM = 4;

const int SERVO_PIN_FR = 2; // Foreleg right
const int SERVO_PIN_FL = 3; // Foreleg left
const int SERVO_PIN_HR = 4; // Hind leg right
const int SERVO_PIN_HL = 5; // Hind leg left

const int SERVO_PIN_ARRAY[SERVO_NUM] = {SERVO_PIN_FR,
                                        SERVO_PIN_FL,
                                        SERVO_PIN_HR,
                                        SERVO_PIN_HL};

const int DONT_MOVE_ANGLE = -999;
const int MOTION_LIST[4][SERVO_NUM] = {
  {115, 80, 97, 90},
  {65, 130, 142, 45},
  {85, DONT_MOVE_ANGLE, DONT_MOVE_ANGLE, DONT_MOVE_ANGLE},
  {65, DONT_MOVE_ANGLE, DONT_MOVE_ANGLE, DONT_MOVE_ANGLE},
};

Servo servo[SERVO_NUM];

void setup() {
  // I2C Setup
  Wire.begin(I2C_SLAVE_ADDRESS);
  Wire.onReceive(onReceiveI2C);
  
  // Servo Setup
  for (int i=0; i<SERVO_NUM; i++) {
    servo[i].attach(SERVO_PIN_ARRAY[i]);
  }
  playMotion(0);
  /*
  delay(5000);
  playMotion(1);
  // Ton-ton
  delay(8000);
  playMotion(2);
  delay(300);
  playMotion(3);
  delay(300);
  playMotion(2);
  delay(300);
  playMotion(3);
  delay(300);
  playMotion(1);
  */
}

void loop() {

}

void playMotion(int motionNum) {
  for (int i=0; i<SERVO_NUM; i++) {
    if(MOTION_LIST[motionNum][i] != DONT_MOVE_ANGLE) {
      servo[i].write(MOTION_LIST[motionNum][i]);
    }
  }
}

void onReceiveI2C(int numBytes) {
  // Read motion number
  byte motionNum = Wire.read();
  playMotion(motionNum);
}